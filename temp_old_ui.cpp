#include "ui.h"
#include "lvgl.h"
#include "esp_wifi.h"
#include "esp_event.h"
#include "esp_netif.h"
#include "esp_log.h"
#include "app_video.h"
#include "quirc.h"
#include "esp_cache.h"
#include "esp_heap_caps.h"
#include "esp_lv_adapter.h"
#include "esp_private/esp_cache_private.h"
#include "bsp/esp-bsp.h"
#include "bme680.h"
#include "xiaozhi_ai_service.h"
#ifdef CONFIG_ELEC_NOSE_GATEWAY_ENABLE
#include "electronic_nose_gateway.h"
#endif
#include "freertos/FreeRTOS.h"
#include "freertos/task.h"
#include "freertos/semphr.h"
#include "lwip/sockets.h"
#include "lwip/inet.h"
#include "lwip/netdb.h"
#include <stdio.h>
#include <stdlib.h>
#include <string.h>
#include <math.h>
#include <unistd.h>
#include <sys/ioctl.h>
#include <linux/videodev2.h>

extern "C" {
    esp_err_t bsp_extra_codec_volume_set(int volume, void* handle);
    esp_err_t bsp_display_brightness_set(int brightness_percent);
    void web_jpeg_encode_frame(const uint8_t *cam_buf, uint32_t w, uint32_t h);
    bool web_jpeg_available(void);
    bool web_jpeg_get_frame(uint8_t **buf, uint32_t *w, uint32_t *h, size_t *len);
}

// ===== 闈欐€?IP 閰嶇疆 =====
#define P4_STATIC_IP       "192.168.110.100"
#define P4_GATEWAY         "192.168.110.1"
#define P4_NETMASK         "255.255.255.0"
#define P4_DNS             "114.114.114.114"
#define P4_DNS_BACKUP      "223.5.5.5"

LV_FONT_DECLARE(lv_font_montserrat_14);
LV_FONT_DECLARE(lv_font_montserrat_24);
LV_FONT_DECLARE(lv_font_montserrat_32);
LV_FONT_DECLARE(lv_font_source_han_sans_sc_14_cjk);

static lv_font_t s_font_cjk_fallback;

static lv_obj_t * scr_startup;
static lv_obj_t * scr_main;
static lv_obj_t * btn_wifi;
static lv_obj_t * wifi_status_label;
static lv_obj_t * cc_overlay;
static lv_obj_t * cc_wifi_status_label;
static lv_obj_t * cc_volume_slider;
static lv_obj_t * cc_volume_label;
static lv_obj_t * cc_brightness_slider;
static bool cc_is_open = false;

static lv_obj_t * env_temp_label;
static lv_obj_t * env_hum_label;
static lv_obj_t * env_press_label;

static lv_obj_t * node1_voc_label;
static lv_obj_t * node1_co2_label;
static lv_obj_t * node1_eth_label;

static lv_obj_t * node2_voc_label;
static lv_obj_t * node2_co2_label;
static lv_obj_t * node2_eth_label;

static lv_timer_t * fake_data_timer;

static lv_obj_t * wifi_list_modal;
static lv_obj_t * wifi_pass_modal;
static lv_obj_t * wifi_pass_title;
static lv_obj_t * ta_pass;
static lv_obj_t * kb;
static char selected_ssid[64] = "";
static lv_obj_t * wifi_list;
static bool wifi_initialized = false;

static lv_obj_t * scr_qr;
static lv_obj_t * cam_img_obj;
static lv_obj_t * qr_result_panel;
static lv_obj_t * qr_result_label;

#ifdef CONFIG_ELEC_NOSE_GATEWAY_ENABLE
static lv_obj_t * ai_analyze_btn;
static lv_obj_t * ai_analyze_btn_label;
static lv_obj_t * ai_result_dialog;
static lv_obj_t * ai_result_dialog_text;
static char s_ai_result_buffer[4096];
static bool s_ai_dialog_open = false;
#endif

#define UDP_SENSOR_PORT 5005

typedef struct {
    bool valid;
    float voc;
    int co2;
    float eth;
} udp_node_data_t;

static udp_node_data_t s_udp_node1 = {};
static udp_node_data_t s_udp_node2 = {};
static SemaphoreHandle_t s_udp_data_mutex = NULL;
static TaskHandle_t s_udp_listener_task = NULL;
static struct quirc *q_cv = NULL;
static int video_fd = -1;
static bool camera_initialized = false;

#define CAM_BUF_NUM 4
static uint8_t *cam_buffers[CAM_BUF_NUM] = {NULL};
static size_t cam_buf_size = 0;
static size_t cam_alignment = 0;

#if LVGL_VERSION_MAJOR == 9
static lv_draw_buf_t cam_draw_buf = {};
#else
static lv_img_dsc_t cam_img_dsc = {};
#endif

static volatile int wifi_conn_status = 0;
static lv_timer_t * wifi_status_timer;
static TaskHandle_t wifi_scan_task_handle = NULL;
static SemaphoreHandle_t wifi_scan_mutex = NULL;
static volatile bool wifi_scan_in_progress = false;
static volatile bool wifi_scan_results_ready = false;
static lv_timer_t * wifi_scan_poll_timer = NULL;
static char wifi_scan_ssids[60][33] = {};
static uint16_t wifi_scan_result_count = 0;
static volatile bool wifi_scan_last_ok = false;
static volatile bool wifi_scan_disconnect_requested = false;

static void update_volume_ui(int vol, bool sync_sliders);
static void set_wifi_status_text(const char * text, lv_color_t color);
static void control_center_init(lv_obj_t * parent);
static void main_screen_event_cb(lv_event_t * e);
static void wifi_scan_task(void * arg);
static void request_wifi_scan(void);
static void wifi_scan_poll_timer_cb(lv_timer_t * timer);
static void render_wifi_scan_results(void);

static void wifi_event_handler(void* arg, esp_event_base_t event_base,
                               int32_t event_id, void* event_data) {
    if (event_base == WIFI_EVENT && event_id == WIFI_EVENT_STA_DISCONNECTED) {
        if (wifi_scan_in_progress || wifi_scan_disconnect_requested) {
            wifi_scan_disconnect_requested = false;
            ESP_LOGI("WIFI", "Wi-Fi disconnected for scan");
            return;
        }

        wifi_conn_status = 3;
        ESP_LOGI("WIFI", "Wi-Fi disconnected, attempting reconnect...");
        esp_wifi_connect();
    } else if (event_base == IP_EVENT && event_id == IP_EVENT_STA_GOT_IP) {
        ip_event_got_ip_t* event = (ip_event_got_ip_t*) event_data;
        ESP_LOGI("WIFI", "Got IP: " IPSTR, IP2STR(&event->ip_info.ip));
        wifi_conn_status = 2;

        // 纭繚 DNS 璁剧疆鐢熸晥
        esp_netif_t *netif = esp_netif_get_handle_from_ifkey("WIFI_STA_DEF");
        if (netif) {
            esp_netif_dns_info_t dns;
            if (esp_netif_get_dns_info(netif, ESP_NETIF_DNS_MAIN, &dns) != ESP_OK || dns.ip.u_addr.ip4.addr == 0) {
                inet_pton(AF_INET, P4_DNS, &dns.ip);
                esp_netif_set_dns_info(netif, ESP_NETIF_DNS_MAIN, &dns);
                inet_pton(AF_INET, P4_DNS_BACKUP, &dns.ip);
                esp_netif_set_dns_info(netif, ESP_NETIF_DNS_BACKUP, &dns);
                ESP_LOGI("WIFI", "DNS reset: main=%s backup=%s", P4_DNS, P4_DNS_BACKUP);
            } else {
                char buf[16];
                inet_ntop(AF_INET, &dns.ip, buf, sizeof(buf));
                ESP_LOGI("WIFI", "DNS already set to %s", buf);
            }
        }
    }
}

static bool camera_display_initialized = false;
static volatile bool camera_stream_stopping = false;
static int frame_skip_counter = 0;
static bool cam_scale_applied = false;
static bool cam_header_set = false;

#define DISP_BUF_COUNT 2
static uint8_t *disp_buffers[DISP_BUF_COUNT] = {NULL};
static int disp_buf_idx = 0;
static volatile bool disp_busy = false;

/* Global style to disable shadows - applied to every container */
static lv_style_t g_style_no_shadow;

static void apply_no_shadow(lv_obj_t * obj) {
    lv_obj_remove_style_all(obj);
    lv_obj_add_style(obj, &g_style_no_shadow, 0);
    lv_obj_add_style(obj, &g_style_no_shadow, LV_PART_SCROLLBAR);
    lv_obj_add_style(obj, &g_style_no_shadow, LV_PART_INDICATOR);
}

static void camera_frame_cb(uint8_t *cam_buf, uint8_t buf_index, uint32_t width, uint32_t height, size_t size) {
    LV_UNUSED(buf_index);

    /* Pre-encode JPEG for web dashboard in this callback (runs in video task context) */
    web_jpeg_encode_frame(cam_buf, width, height);

    if (!camera_display_initialized || camera_stream_stopping) {
        return;
    }

    /* Debug: log every 60th frame to confirm callback is running */
    static int cb_debug_counter = 0;
    if (++cb_debug_counter % 60 == 1) {
        ESP_LOGI("CAM", "frame_cb: %lux%lu disp_init=%d skip_cnt=%d",
                 (unsigned long)width, (unsigned long)height,
                 camera_display_initialized, frame_skip_counter);
    }

    if (disp_buffers[0] == NULL) {
        size_t align;
        esp_cache_get_alignment(MALLOC_CAP_SPIRAM, &align);
        for (int i = 0; i < DISP_BUF_COUNT; i++) {
            disp_buffers[i] = (uint8_t *)heap_caps_aligned_alloc(align, size, MALLOC_CAP_SPIRAM);
            ESP_LOGI("CAM", "Display buffer %d allocated: %p", i, disp_buffers[i]);
        }
    }

    if (++frame_skip_counter % 4 != 0) {
        return;
    }

    uint8_t *curr_buf = disp_buffers[disp_buf_idx];
    memcpy(curr_buf, cam_buf, size);

    static int qr_throttle = 0;
    if (++qr_throttle % 4 == 0) {
        #define QR_W 200
        #define QR_H 150
        static uint8_t *qr_gray = NULL;
        static size_t qr_gray_size = 0;
        
        if (qr_gray == NULL || qr_gray_size != QR_W * QR_H) {
            if (qr_gray) {
                heap_caps_free(qr_gray);
                qr_gray = NULL;
            }
            qr_gray_size = QR_W * QR_H;
            qr_gray = (uint8_t *)heap_caps_malloc(qr_gray_size, MALLOC_CAP_SPIRAM);
            if (qr_gray) {
                ESP_LOGI("QR", "QR gray buffer: %dx%d", QR_W, QR_H);
            } else {
                ESP_LOGE("QR", "Failed to allocate QR gray buffer");
                return;
            }
        }
        
        if (qr_gray) {
            /* Cache source mapping (recompute only when dimensions change) */
            static uint32_t s_qr_src_w = 0, s_qr_src_h = 0;
            static int s_qr_src_row_ofs[QR_H];
            static int32_t s_qr_x_step;
            if (s_qr_src_w != width || s_qr_src_h != height) {
                for (int y = 0; y < QR_H; y++)
                    s_qr_src_row_ofs[y] = (y * height / QR_H) * width;
                s_qr_x_step = ((int32_t)width << 16) / QR_W;
                s_qr_src_w = width;
                s_qr_src_h = height;
            }
            /* Fixed-point stepping: no per-pixel division; shift replaces /1000 */
            const uint16_t *src_base = (const uint16_t*)curr_buf;
            uint8_t *dst_qr = qr_gray;
            for (int y = 0; y < QR_H; y++) {
                const uint16_t *src_row = src_base + s_qr_src_row_ofs[y];
                int32_t x_fp = 0;
                for (int x = 0; x < QR_W; x++) {
                    uint16_t p = src_row[x_fp >> 16];
                    uint8_t r = (p >> 8) & 0xF8;
                    uint8_t g = (p >> 3) & 0xFC;
                    uint8_t b = (p << 3) & 0xF8;
                    *dst_qr++ = (r * 77 + g * 150 + b * 29) >> 8;
                    x_fp += s_qr_x_step;
                }
            }
            
            static int quirc_failed_count = 0;
            
            if (q_cv && quirc_failed_count > 10) {
                quirc_destroy(q_cv);
                q_cv = NULL;
                quirc_failed_count = 0;
            }
            
            if (!q_cv) {
                q_cv = quirc_new();
                if (q_cv) {
                    quirc_resize(q_cv, QR_W, QR_H);
                }
            }
            
            if (q_cv && qr_gray) {
                int qw = QR_W, qh = QR_H;
                uint8_t *qbuf = quirc_begin(q_cv, &qw, &qh);
                
                if (qbuf && qw == QR_W && qh == QR_H) {
                    memcpy(qbuf, qr_gray, QR_W * QR_H);
                    quirc_end(q_cv);
                    quirc_failed_count = 0;
                    
                    int num = quirc_count(q_cv);
                    if (num > 0) {
                        ESP_LOGI("QR", "Found %d QR!", num);
                        for (int i = 0; i < num; i++) {
                            struct quirc_code code;
                            struct quirc_data data;
                            quirc_extract(q_cv, i, &code);
                            if (quirc_decode(&code, &data) == 0) {
                                ESP_LOGI("QR", "SUCCESS: %s", data.payload);
                                
                                const char* payload = (const char*)data.payload;
                                char node_id[32] = "Unknown";
                                float voc = 0, eth = 0;
                                int co2 = 0;
                                
                                if (strstr(payload, "S3_A") || strstr(payload, "S3A")) {
                                    strcpy(node_id, "S3_A");
                                    voc = 1.2f; co2 = 520; eth = 2.3f;
                                } else if (strstr(payload, "S3_B") || strstr(payload, "S3B")) {
                                    strcpy(node_id, "S3_B");
                                    voc = 2.5f; co2 = 680; eth = 1.8f;
                                } else if (strstr(payload, "S3")) {
                                    strcpy(node_id, "S3");
                                    voc = 1.0f + (rand() % 100) / 10.0f;
                                    co2 = 400 + rand() % 200;
                                    eth = 0.5f + (rand() % 50) / 10.0f;
                                }
                                
                                if (qr_result_label) {
                                    char info[256];
                                    snprintf(info, sizeof(info), "Node: %s\nVOC: %.1f\nCO2: %d\nEth: %.1f",
                                            node_id, voc, co2, eth);
                                    
                                    const char* current_text = lv_label_get_text(qr_result_label);
                                    if (strcmp(current_text, info) != 0) {
                                        lv_label_set_text(qr_result_label, info);
                                        lv_obj_remove_flag(qr_result_panel, LV_OBJ_FLAG_HIDDEN);
                                        lv_obj_set_style_bg_color(qr_result_panel, lv_color_hex(0x003300), 0);
                                    }
                                }
                            }
                        }
                    }
                } else {
                    quirc_failed_count++;
                    if (quirc_failed_count == 1) {
                        ESP_LOGW("QR", "quirc_begin failed (count=%d)", quirc_failed_count);
                    }
                }
            }
        }
    }

    if (camera_display_initialized && cam_img_obj != NULL) {
        esp_err_t lock_ret = esp_lv_adapter_lock(pdMS_TO_TICKS(100));
        if (lock_ret == ESP_OK) {
#if LVGL_VERSION_MAJOR == 9
            uint32_t stride = lv_draw_buf_width_to_stride(width, LV_COLOR_FORMAT_RGB565);
            if (stride * height > size) {
                ESP_LOGW("CAM", "stride*%lu=%lu > size=%zu, fallback to width*2",
                         (unsigned long)height, (unsigned long)(stride * height), size);
                stride = width * 2;
            }
            lv_result_t db_ret = lv_draw_buf_init(&cam_draw_buf, width, height, LV_COLOR_FORMAT_RGB565,
                                                  stride, curr_buf, size);
            if (db_ret != LV_RESULT_OK) {
                ESP_LOGE("CAM", "lv_draw_buf_init FAILED! ret=%d stride=%u size=%zu",
                         (int)db_ret, (unsigned)stride, size);
                esp_lv_adapter_unlock();
                return;
            }
            /* Do NOT use LV_IMAGE_FLAGS_ALLOCATED - it causes draw_buf_flush hang */
            lv_image_set_src(cam_img_obj, &cam_draw_buf);

            if (!cam_scale_applied) {
                int32_t obj_w = lv_obj_get_width(cam_img_obj);
                int32_t obj_h = lv_obj_get_height(cam_img_obj);
                ESP_LOGI("CAM", "set_src: obj=%ldx%ld img=%lux%lu stride=%u",
                         (long)obj_w, (long)obj_h,
                         (unsigned long)width, (unsigned long)height, (unsigned)stride);
                if (obj_w > 0 && obj_h > 0) {
                    lv_obj_set_pos(cam_img_obj, (1024 - width) / 2, 60 + (540 - height) / 2);
                    cam_scale_applied = true;
                }
            }
#else
            if (!cam_header_set) {
                cam_img_dsc.header.always_zero = 0;
                cam_img_dsc.header.cf = LV_IMG_CF_TRUE_COLOR;
                cam_img_dsc.header.w = width;
                cam_img_dsc.header.h = height;
                cam_img_dsc.data_size = size;
                cam_header_set = true;
            }
            cam_img_dsc.data = curr_buf;
            lv_img_set_src(cam_img_obj, &cam_img_dsc);
#endif
            disp_buf_idx = (disp_buf_idx + 1) % DISP_BUF_COUNT;
            esp_lv_adapter_unlock();
        } else {
            static int lock_fail_cnt = 0;
            if (++lock_fail_cnt % 120 == 1) {
                ESP_LOGW("CAM", "LVGL lock failed %d times", lock_fail_cnt);
            }
        }
    }
}

static void fake_data_timer_cb(lv_timer_t * timer) {
    extern float g_temperature;
    extern float g_humidity;
    extern float g_pressure;

    int temp_int = (int)(g_temperature * 10);
    int hum_int = (int)(g_humidity * 10);
    int press_int = (int)g_pressure;
    lv_label_set_text_fmt(env_temp_label, "Temp: %d.%dC", temp_int / 10, temp_int % 10);
    lv_label_set_text_fmt(env_hum_label, "Humidity: %d.%d%%", hum_int / 10, hum_int % 10);
    lv_label_set_text_fmt(env_press_label, "Pressure: %dhPa", press_int);

    if (s_udp_data_mutex != NULL && xSemaphoreTake(s_udp_data_mutex, pdMS_TO_TICKS(10)) == pdTRUE) {
        if (s_udp_node1.valid) {
            lv_label_set_text_fmt(node1_voc_label, "VOC: %.1f ppm", (double)s_udp_node1.voc);
            lv_label_set_text_fmt(node1_co2_label, "CO2: %d ppm", s_udp_node1.co2);
            lv_label_set_text_fmt(node1_eth_label, "Ethylene: %.1f ppm", (double)s_udp_node1.eth);
        }

        if (s_udp_node2.valid) {
            lv_label_set_text_fmt(node2_voc_label, "VOC: %.1f ppm", (double)s_udp_node2.voc);
            lv_label_set_text_fmt(node2_co2_label, "CO2: %d ppm", s_udp_node2.co2);
            lv_label_set_text_fmt(node2_eth_label, "Ethylene: %.1f ppm", (double)s_udp_node2.eth);
        }
        xSemaphoreGive(s_udp_data_mutex);
    }
}

static bool parse_udp_sensor_packet(const char * payload, char * node, size_t node_len, float * voc, int * co2, float * eth) {
    LV_UNUSED(node_len);

    /* Accept the required JSON prefix and ignore any extra debug fields after eth. */
    if (sscanf(payload, "{\"node\":\"%31[^\"]\",\"voc\":%f,\"co2\":%d,\"eth\":%f", node, voc, co2, eth) == 4) {
        return true;
    }

    /* Also accept a minimal JSON packet that ends right after eth. */
    if (sscanf(payload, "{\"node\":\"%31[^\"]\",\"voc\":%f,\"co2\":%d,\"eth\":%f}", node, voc, co2, eth) == 4) {
        return true;
    }

    if (sscanf(payload, "node=%31[^,],voc=%f,co2=%d,eth=%f", node, voc, co2, eth) == 4) {
        return true;
    }

    return false;
}

static void udp_listener_task(void * arg) {
    LV_UNUSED(arg);

    int sock = socket(AF_INET, SOCK_DGRAM, IPPROTO_UDP);
    if (sock < 0) {
        ESP_LOGE("UDP", "Failed to create UDP socket");
        vTaskDelete(NULL);
        return;
    }

    struct sockaddr_in addr = {};
    addr.sin_family = AF_INET;
    addr.sin_port = htons(UDP_SENSOR_PORT);
    addr.sin_addr.s_addr = htonl(INADDR_ANY);

    if (bind(sock, (struct sockaddr *)&addr, sizeof(addr)) != 0) {
        ESP_LOGE("UDP", "Failed to bind UDP port %d", UDP_SENSOR_PORT);
        closesocket(sock);
        vTaskDelete(NULL);
        return;
    }

    ESP_LOGI("UDP", "Listening for S3 sensor packets on UDP %d", UDP_SENSOR_PORT);

    char rx_buf[256];
    while (true) {
        struct sockaddr_in source_addr = {};
        socklen_t socklen = sizeof(source_addr);
        int len = recvfrom(sock, rx_buf, sizeof(rx_buf) - 1, 0, (struct sockaddr *)&source_addr, &socklen);
        if (len <= 0) {
            continue;
        }

        rx_buf[len] = '\0';

        char node[32] = {};
        float voc = 0.0f;
        int co2 = 0;
        float eth = 0.0f;
        if (!parse_udp_sensor_packet(rx_buf, node, sizeof(node), &voc, &co2, &eth)) {
            ESP_LOGW("UDP", "Ignored packet: %s", rx_buf);
            continue;
        }

        ESP_LOGI("UDP", "RX node=%s voc=%.1f co2=%d eth=%.1f", node, (double)voc, co2, (double)eth);

        if (s_udp_data_mutex != NULL && xSemaphoreTake(s_udp_data_mutex, pdMS_TO_TICKS(50)) == pdTRUE) {
            udp_node_data_t * target = NULL;
            if (strcmp(node, "S3_A") == 0 || strcmp(node, "S3A") == 0 || strcmp(node, "Node S3-A") == 0) {
                target = &s_udp_node1;
            } else if (strcmp(node, "S3_B") == 0 || strcmp(node, "S3B") == 0 || strcmp(node, "Node S3-B") == 0) {
                target = &s_udp_node2;
            }

            if (target != NULL) {
                target->valid = true;
                target->voc = voc;
                target->co2 = co2;
                target->eth = eth;
            }
            xSemaphoreGive(s_udp_data_mutex);
        }
    }
}

static void vol_slider_event_cb(lv_event_t * e) {
    lv_obj_t * slider = (lv_obj_t *)lv_event_get_target(e);
    int vol = (int)lv_slider_get_value(slider);
    bsp_extra_codec_volume_set(vol, NULL);
    update_volume_ui(vol, false);
}

static void btn_enter_event_handler(lv_event_t * e) {
    lv_event_code_t code = lv_event_get_code(e);
    if (code == LV_EVENT_CLICKED) {
        lv_screen_load(scr_main);
        if (s_udp_data_mutex == NULL) {
            s_udp_data_mutex = xSemaphoreCreateMutex();
        }
        // BLE Central now handles sensor data reception (via C6 co-processor)
        // UDP listener is deprecated but can be re-enabled for debugging:
        // xTaskCreatePinnedToCore(udp_listener_task, "udp_sensor", 6144, NULL, 4, &s_udp_listener_task, 1);
        if (fake_data_timer == NULL) {
            fake_data_timer = lv_timer_create(fake_data_timer_cb, 500, NULL);
        }
    }
}

static void ta_event_cb(lv_event_t * e) {
    lv_event_code_t code = lv_event_get_code(e);
    lv_obj_t * ta = (lv_obj_t*)lv_event_get_target(e);
    if (code == LV_EVENT_FOCUSED) {
        lv_keyboard_set_textarea(kb, ta);
        lv_obj_remove_flag(kb, LV_OBJ_FLAG_HIDDEN);
        lv_obj_move_foreground(kb);
    } else if (code == LV_EVENT_DEFOCUSED) {
        lv_keyboard_set_textarea(kb, NULL);
        lv_obj_add_flag(kb, LV_OBJ_FLAG_HIDDEN);
    }
}

static void wifi_status_timer_cb(lv_timer_t * timer) {
    if (wifi_conn_status == 2) {
        char status_text[128];
        snprintf(status_text, sizeof(status_text), "WiFi: %s", selected_ssid);
        set_wifi_status_text(status_text, lv_color_hex(0x00FF00));
        lv_timer_delete(timer);
        wifi_status_timer = NULL;
    } else if (wifi_conn_status == 3) {
        set_wifi_status_text("WiFi: Password Error!", lv_color_hex(0xFF0000));
        lv_timer_delete(timer);
        wifi_status_timer = NULL;
    }
}

static void wifi_connect_btn_cb(lv_event_t * e) {
    LV_UNUSED(e);
    lv_obj_add_flag(wifi_pass_modal, LV_OBJ_FLAG_HIDDEN);
    set_wifi_status_text("WiFi: Connecting...", lv_color_hex(0xFFA500));

    const char * pass = lv_textarea_get_text(ta_pass);

    esp_wifi_scan_stop();
    wifi_config_t wifi_config = {};
    snprintf((char*)wifi_config.sta.ssid, sizeof(wifi_config.sta.ssid), "%s", selected_ssid);
    snprintf((char*)wifi_config.sta.password, sizeof(wifi_config.sta.password), "%s", pass);

    ESP_LOGI("WIFI", "Connecting to %s...", selected_ssid);
    esp_wifi_set_config(WIFI_IF_STA, &wifi_config);
    esp_wifi_connect();

    wifi_conn_status = 1;
    if(wifi_status_timer == NULL) {
        wifi_status_timer = lv_timer_create(wifi_status_timer_cb, 500, NULL);
    }
}

static void wifi_pass_back_btn_cb(lv_event_t * e) {
    LV_UNUSED(e);
    lv_obj_add_flag(wifi_pass_modal, LV_OBJ_FLAG_HIDDEN);
    lv_obj_add_flag(kb, LV_OBJ_FLAG_HIDDEN);
    lv_obj_move_foreground(wifi_list_modal);
    lv_obj_remove_flag(wifi_list_modal, LV_OBJ_FLAG_HIDDEN);
}

static void wifi_list_close_btn_cb(lv_event_t * e) {
    lv_obj_add_flag(wifi_list_modal, LV_OBJ_FLAG_HIDDEN);
}

static void wifi_list_btn_cb(lv_event_t * e) {
    lv_obj_t * list_btn = (lv_obj_t*)lv_event_get_target(e);
    lv_obj_t * list = (lv_obj_t*)lv_obj_get_parent(list_btn);
    const char * ssid = lv_list_get_btn_text(list, list_btn);
    if(ssid) {
        snprintf(selected_ssid, sizeof(selected_ssid), "%s", ssid);
        char title_text[128];
        snprintf(title_text, sizeof(title_text), "Password for: %s", ssid);
        lv_label_set_text(wifi_pass_title, title_text);
        lv_textarea_set_text(ta_pass, "");
        lv_obj_add_flag(wifi_list_modal, LV_OBJ_FLAG_HIDDEN);
        lv_obj_remove_flag(wifi_pass_modal, LV_OBJ_FLAG_HIDDEN);
    }
}

static void ensure_wifi_ready(void) {
    if(!wifi_initialized) {
        esp_netif_t *netif = esp_netif_create_default_wifi_sta();

        // 璁剧疆闈欐€?IP
        esp_netif_dhcpc_stop(netif);
        esp_netif_ip_info_t ip_info;
        inet_pton(AF_INET, P4_STATIC_IP, &ip_info.ip);
        inet_pton(AF_INET, P4_GATEWAY, &ip_info.gw);
        inet_pton(AF_INET, P4_NETMASK, &ip_info.netmask);
        esp_netif_set_ip_info(netif, &ip_info);
        ESP_LOGI("WIFI", "Static IP set to %s", P4_STATIC_IP);

        // 璁剧疆 DNS
        esp_netif_dns_info_t dns_info;
        inet_pton(AF_INET, P4_DNS, &dns_info.ip);
        esp_netif_set_dns_info(netif, ESP_NETIF_DNS_MAIN, &dns_info);
        esp_netif_dns_info_t dns_backup;
        inet_pton(AF_INET, P4_DNS_BACKUP, &dns_backup.ip);
        esp_netif_set_dns_info(netif, ESP_NETIF_DNS_BACKUP, &dns_backup);
        ESP_LOGI("WIFI", "DNS main=%s backup=%s", P4_DNS, P4_DNS_BACKUP);

        wifi_init_config_t cfg = WIFI_INIT_CONFIG_DEFAULT();
        esp_wifi_init(&cfg);
        esp_event_handler_instance_register(WIFI_EVENT, ESP_EVENT_ANY_ID, &wifi_event_handler, NULL, NULL);
        esp_event_handler_instance_register(IP_EVENT, IP_EVENT_STA_GOT_IP, &wifi_event_handler, NULL, NULL);
        esp_wifi_set_mode(WIFI_MODE_STA);
        esp_wifi_start();
        wifi_initialized = true;
    }
}

static void render_wifi_scan_results(void) {
    lv_obj_clean(wifi_list);

    if (wifi_scan_mutex == NULL || xSemaphoreTake(wifi_scan_mutex, pdMS_TO_TICKS(20)) != pdTRUE) {
        lv_list_add_text(wifi_list, "Scan Busy");
        return;
    }

    uint16_t number = wifi_scan_result_count;
    bool scan_ok = wifi_scan_last_ok;
    xSemaphoreGive(wifi_scan_mutex);

    if (!scan_ok) {
        lv_list_add_text(wifi_list, "Scan Failed");
        return;
    }

    if (number == 0) {
        lv_list_add_text(wifi_list, "No Networks Found");
        return;
    }

    for (uint16_t i = 0; i < number; i++) {
        if (wifi_scan_ssids[i][0] == '\0') {
            continue;
        }
        lv_obj_t * btn = lv_list_add_btn(wifi_list, LV_SYMBOL_WIFI, wifi_scan_ssids[i]);
        lv_obj_add_event_cb(btn, wifi_list_btn_cb, LV_EVENT_CLICKED, NULL);
    }
}

static void wifi_scan_poll_timer_cb(lv_timer_t * timer) {
    LV_UNUSED(timer);

    if (wifi_scan_in_progress) {
        return;
    }

    if (!wifi_scan_results_ready) {
        return;
    }

    wifi_scan_results_ready = false;
    render_wifi_scan_results();
}

static void wifi_scan_task(void * arg) {
    LV_UNUSED(arg);

    while (true) {
        ulTaskNotifyTake(pdTRUE, portMAX_DELAY);

        ensure_wifi_ready();
        wifi_scan_in_progress = true;
        wifi_scan_results_ready = false;
        wifi_scan_last_ok = false;

        wifi_scan_disconnect_requested = true;
        esp_wifi_disconnect();
        esp_err_t err = esp_wifi_scan_start(NULL, true);
        ESP_LOGI("WIFI", "Scan start result: %s", esp_err_to_name(err));

        if (wifi_scan_mutex && xSemaphoreTake(wifi_scan_mutex, pdMS_TO_TICKS(200)) == pdTRUE) {
            memset(wifi_scan_ssids, 0, sizeof(wifi_scan_ssids));
            wifi_scan_result_count = 0;

            if (err == ESP_OK) {
                uint16_t number = 60;
                wifi_ap_record_t *ap_records = (wifi_ap_record_t *)malloc(sizeof(wifi_ap_record_t) * number);
                if (ap_records != NULL) {
                    memset(ap_records, 0, sizeof(wifi_ap_record_t) * number);
                    if (esp_wifi_scan_get_ap_records(&number, ap_records) == ESP_OK) {
                        ESP_LOGI("WIFI", "Scan found %u APs", number);
                        for (uint16_t i = 0; i < number && wifi_scan_result_count < 60; i++) {
                            if (ap_records[i].ssid[0] == '\0') {
                                continue;
                            }
                            strncpy(wifi_scan_ssids[wifi_scan_result_count], (const char *)ap_records[i].ssid, sizeof(wifi_scan_ssids[0]) - 1);
                            wifi_scan_ssids[wifi_scan_result_count][sizeof(wifi_scan_ssids[0]) - 1] = '\0';
                            wifi_scan_result_count++;
                        }
                        wifi_scan_last_ok = true;
                    }
                    free(ap_records);
                }
            }

            if (err != ESP_OK) {
                ESP_LOGE("WIFI", "esp_wifi_scan_start failed: %s", esp_err_to_name(err));
            }

            xSemaphoreGive(wifi_scan_mutex);
        }

        wifi_scan_in_progress = false;
        wifi_scan_results_ready = true;
    }
}

static void request_wifi_scan(void) {
    ensure_wifi_ready();

    if (wifi_scan_mutex == NULL) {
        wifi_scan_mutex = xSemaphoreCreateMutex();
    }
    if (wifi_scan_task_handle == NULL) {
        xTaskCreatePinnedToCore(wifi_scan_task, "wifi_scan", 12288, NULL, 5, &wifi_scan_task_handle, 1);
    }
    if (wifi_scan_poll_timer == NULL) {
        wifi_scan_poll_timer = lv_timer_create(wifi_scan_poll_timer_cb, 150, NULL);
    }

    wifi_scan_in_progress = true;
    wifi_scan_results_ready = false;
    xTaskNotifyGive(wifi_scan_task_handle);
}

static void init_and_scan_wifi(lv_obj_t * list) {
    LV_UNUSED(list);

    request_wifi_scan();
}

static void wifi_scan_timer_cb(lv_timer_t * timer) {
    init_and_scan_wifi(wifi_list);
    lv_timer_delete(timer);
}

static void btn_open_wifi_cb(lv_event_t * e) {
    LV_UNUSED(e);
    lv_obj_move_foreground(wifi_list_modal);
    lv_obj_remove_flag(wifi_list_modal, LV_OBJ_FLAG_HIDDEN);
    lv_obj_clean(wifi_list);
    lv_list_add_text(wifi_list, "Scanning...");
    lv_timer_create(wifi_scan_timer_cb, 50, NULL);
}

static void create_wifi_modals(void) {
    lv_obj_t * overlay_parent = lv_layer_top();

    wifi_list_modal = lv_obj_create(overlay_parent);
    apply_no_shadow(wifi_list_modal);
    lv_obj_set_size(wifi_list_modal, 400, 300);
    lv_obj_align(wifi_list_modal, LV_ALIGN_TOP_MID, 0, 50);
    lv_obj_set_style_bg_color(wifi_list_modal, lv_color_hex(0x303030), 0);
    lv_obj_set_style_bg_opa(wifi_list_modal, LV_OPA_COVER, 0);
    lv_obj_set_style_border_color(wifi_list_modal, lv_color_hex(0x555555), 0);
    lv_obj_set_style_border_width(wifi_list_modal, 1, 0);
    lv_obj_set_style_radius(wifi_list_modal, 12, 0);
    lv_obj_add_flag(wifi_list_modal, LV_OBJ_FLAG_HIDDEN);

    lv_obj_t * list_title = lv_label_create(wifi_list_modal);
    lv_label_set_text(list_title, "Available Wi-Fi Networks");
    lv_obj_set_style_text_color(list_title, lv_color_hex(0xFFFFFF), 0);
    lv_obj_align(list_title, LV_ALIGN_TOP_MID, 0, 0);

    lv_obj_t * close_btn = lv_btn_create(wifi_list_modal);
    lv_obj_align(close_btn, LV_ALIGN_TOP_RIGHT, 0, 0);
    lv_obj_t * close_lbl = lv_label_create(close_btn);
    lv_label_set_text(close_lbl, "X");
    lv_obj_add_event_cb(close_btn, wifi_list_close_btn_cb, LV_EVENT_CLICKED, NULL);

    wifi_list = lv_list_create(wifi_list_modal);
    lv_obj_set_size(wifi_list, 360, 220);
    lv_obj_align(wifi_list, LV_ALIGN_BOTTOM_MID, 0, 0);

    wifi_pass_modal = lv_obj_create(overlay_parent);
    apply_no_shadow(wifi_pass_modal);
    lv_obj_set_size(wifi_pass_modal, 400, 300);
    lv_obj_align(wifi_pass_modal, LV_ALIGN_TOP_MID, 0, 50);
    lv_obj_set_style_bg_color(wifi_pass_modal, lv_color_hex(0x303030), 0);
    lv_obj_set_style_bg_opa(wifi_pass_modal, LV_OPA_COVER, 0);
    lv_obj_set_style_border_color(wifi_pass_modal, lv_color_hex(0x555555), 0);
    lv_obj_set_style_border_width(wifi_pass_modal, 1, 0);
    lv_obj_set_style_radius(wifi_pass_modal, 12, 0);
    lv_obj_add_flag(wifi_pass_modal, LV_OBJ_FLAG_HIDDEN);

    wifi_pass_title = lv_label_create(wifi_pass_modal);
    lv_label_set_text(wifi_pass_title, "Enter password");
    lv_obj_set_style_text_color(wifi_pass_title, lv_color_hex(0xFFFFFF), 0);
    lv_obj_align(wifi_pass_title, LV_ALIGN_TOP_MID, 0, 0);

    ta_pass = lv_textarea_create(wifi_pass_modal);
    lv_textarea_set_placeholder_text(ta_pass, "Password...");
    lv_textarea_set_password_mode(ta_pass, true);
    lv_obj_set_width(ta_pass, 300);
    lv_obj_align(ta_pass, LV_ALIGN_TOP_MID, 0, 50);
    lv_obj_add_event_cb(ta_pass, ta_event_cb, LV_EVENT_ALL, NULL);

    lv_obj_t * btn_conn = lv_btn_create(wifi_pass_modal);
    lv_obj_align(btn_conn, LV_ALIGN_BOTTOM_RIGHT, -20, -10);
    lv_obj_add_event_cb(btn_conn, wifi_connect_btn_cb, LV_EVENT_CLICKED, NULL);
    lv_obj_t * lbl_conn = lv_label_create(btn_conn);
    lv_label_set_text(lbl_conn, "Connect");

    lv_obj_t * btn_back = lv_btn_create(wifi_pass_modal);
    lv_obj_align(btn_back, LV_ALIGN_BOTTOM_LEFT, 20, -10);
    lv_obj_add_event_cb(btn_back, wifi_pass_back_btn_cb, LV_EVENT_CLICKED, NULL);
    lv_obj_t * lbl_back = lv_label_create(btn_back);
    lv_label_set_text(lbl_back, "Back");

    kb = lv_keyboard_create(overlay_parent);
    lv_obj_add_flag(kb, LV_OBJ_FLAG_HIDDEN);
}

static lv_obj_t * create_node_panel(lv_obj_t * parent, const char * title,
    lv_obj_t ** voc_lbl, lv_obj_t ** co2_lbl, lv_obj_t ** eth_lbl) {
    
    lv_obj_t * panel = lv_obj_create(parent);
    apply_no_shadow(panel);
    lv_obj_set_size(panel, 300, 150);
    lv_obj_set_flex_flow(panel, LV_FLEX_FLOW_COLUMN);
    lv_obj_set_flex_align(panel, LV_FLEX_ALIGN_START, LV_FLEX_ALIGN_START, LV_FLEX_ALIGN_START);
    lv_obj_set_style_bg_color(panel, lv_color_hex(0x1A1A2E), 0);
    lv_obj_set_style_bg_opa(panel, LV_OPA_COVER, 0);
    lv_obj_set_style_border_color(panel, lv_color_hex(0x333355), 0);
    lv_obj_set_style_border_width(panel, 1, 0);
    lv_obj_set_style_radius(panel, 12, 0);

    lv_obj_t * title_label = lv_label_create(panel);
    lv_label_set_text(title_label, title);
    lv_obj_set_style_text_font(title_label, &lv_font_montserrat_24, 0);
    lv_obj_set_style_text_color(title_label, lv_color_hex(0x0078FF), 0);

    *voc_lbl = lv_label_create(panel);
    lv_label_set_text(*voc_lbl, "VOC: waiting BLE");

    *co2_lbl = lv_label_create(panel);
    lv_label_set_text(*co2_lbl, "CO2: waiting BLE");

    *eth_lbl = lv_label_create(panel);
    lv_label_set_text(*eth_lbl, "Ethylene: waiting BLE");

    return panel;
}

#ifdef CONFIG_ELEC_NOSE_GATEWAY_ENABLE
static void ai_analyze_btn_cb(lv_event_t * e) {
    char sensor_json[512];
    bool has_data = false;

    extern float g_temperature;
    extern float g_humidity;
    extern float g_pressure;

    if (s_udp_data_mutex != NULL && xSemaphoreTake(s_udp_data_mutex, pdMS_TO_TICKS(50)) == pdTRUE) {
        float voc = s_udp_node1.valid ? s_udp_node1.voc : 0.0f;
        int co2 = s_udp_node1.valid ? s_udp_node1.co2 : 400;
        float eth = s_udp_node1.valid ? s_udp_node1.eth : 0.0f;
        xSemaphoreGive(s_udp_data_mutex);

        snprintf(sensor_json, sizeof(sensor_json),
            "{\"node\":\"S3_A\",\"voc\":%.1f,\"co2\":%d,\"eth\":%.1f,"
            "\"hcho\":0.05,\"co\":1.0,\"temp\":%.1f,\"humi\":%.1f}",
            (double)voc, co2, (double)eth, (double)g_temperature, (double)g_humidity);
        has_data = true;
    }

    if (!has_data) {
        snprintf(sensor_json, sizeof(sensor_json),
            "{\"node\":\"S3_A\",\"voc\":8.5,\"co2\":600,\"eth\":1.5,"
            "\"hcho\":0.05,\"co\":1.0,\"temp\":%.1f,\"humi\":%.1f}",
            (double)g_temperature, (double)g_humidity);
    }

    esp_err_t err = electronic_nose_gateway_trigger_analysis(sensor_json, strlen(sensor_json));
    if (err == ESP_OK) {
        lv_label_set_text(ai_analyze_btn_label, "Analyzing...");
        lv_obj_set_style_bg_color(ai_analyze_btn, lv_color_hex(0x7A5C00), 0);
        lv_obj_add_state(ai_analyze_btn, LV_STATE_DISABLED);
    }
}

static void ai_dialog_close_cb(lv_event_t * e) {
    if (ai_result_dialog) {
        lv_obj_del(ai_result_dialog);
        ai_result_dialog = NULL;
        s_ai_dialog_open = false;
    }
    lv_obj_clear_state(ai_analyze_btn, LV_STATE_DISABLED);
    lv_label_set_text(ai_analyze_btn_label, "AI Analysis");
    lv_obj_set_style_bg_color(ai_analyze_btn, lv_color_hex(0x4AA3FF), 0);
}

static void create_ai_result_dialog(const char * result) {
    if (s_ai_dialog_open) return;
    s_ai_dialog_open = true;

    ai_result_dialog = lv_obj_create(lv_layer_top());
    apply_no_shadow(ai_result_dialog);
    lv_obj_set_size(ai_result_dialog, 940, 540);
    lv_obj_center(ai_result_dialog);
    lv_obj_set_style_bg_color(ai_result_dialog, lv_color_hex(0x0B1020), 0);
    lv_obj_set_style_bg_opa(ai_result_dialog, LV_OPA_COVER, 0);
    lv_obj_set_style_border_color(ai_result_dialog, lv_color_hex(0x4AA3FF), 0);
    lv_obj_set_style_border_width(ai_result_dialog, 2, 0);
    lv_obj_set_style_radius(ai_result_dialog, 18, 0);

    lv_obj_t * title = lv_label_create(ai_result_dialog);
    lv_label_set_text(title, "AI Analysis Result");
    lv_obj_set_style_text_font(title, &lv_font_montserrat_24, 0);
    lv_obj_set_style_text_color(title, lv_color_hex(0x4AA3FF), 0);
    lv_obj_align(title, LV_ALIGN_TOP_LEFT, 20, 14);

    lv_obj_t * close_btn = lv_btn_create(ai_result_dialog);
    lv_obj_set_size(close_btn, 80, 36);
    lv_obj_align(close_btn, LV_ALIGN_TOP_RIGHT, -14, 12);
    lv_obj_set_style_bg_color(close_btn, lv_color_hex(0x444444), 0);
    lv_obj_set_style_radius(close_btn, 10, 0);
    lv_obj_t * close_lbl = lv_label_create(close_btn);
    lv_label_set_text(close_lbl, "Close");
    lv_obj_center(close_lbl);
    lv_obj_set_style_text_color(close_lbl, lv_color_hex(0xFFFFFF), 0);
    lv_obj_add_event_cb(close_btn, ai_dialog_close_cb, LV_EVENT_CLICKED, NULL);

    lv_obj_t * text_area = lv_obj_create(ai_result_dialog);
    apply_no_shadow(text_area);
    lv_obj_set_size(text_area, 890, 440);
    lv_obj_align(text_area, LV_ALIGN_BOTTOM_MID, 0, -10);
    lv_obj_set_style_bg_color(text_area, lv_color_hex(0x151C30), 0);
    lv_obj_set_style_border_color(text_area, lv_color_hex(0x26324A), 0);
    lv_obj_set_style_border_width(text_area, 1, 0);
    lv_obj_set_style_radius(text_area, 12, 0);
    lv_obj_set_flex_flow(text_area, LV_FLEX_FLOW_COLUMN);

    ai_result_dialog_text = lv_label_create(text_area);
    lv_label_set_text(ai_result_dialog_text, result ? result : "(empty)");
    lv_label_set_long_mode(ai_result_dialog_text, LV_LABEL_LONG_WRAP);
    lv_obj_set_width(ai_result_dialog_text, 850);
    lv_obj_set_style_text_font(ai_result_dialog_text, &s_font_cjk_fallback, 0);
    lv_obj_set_style_text_color(ai_result_dialog_text, lv_color_hex(0xE6ECF5), 0);
    lv_obj_set_style_text_line_space(ai_result_dialog_text, 4, 0);
}

void ui_show_ai_analysis(const char* result) {
    if (!result) return;
    strlcpy(s_ai_result_buffer, result, sizeof(s_ai_result_buffer));

    esp_err_t lock_ret = esp_lv_adapter_lock(pdMS_TO_TICKS(1000));
    if (lock_ret == ESP_OK) {
        create_ai_result_dialog(s_ai_result_buffer);
        esp_lv_adapter_unlock();
    }
}

void ui_handle_sensor_data(const char *node, float voc, int co2, float eth) {
    if (!node || !s_udp_data_mutex) return;

    if (xSemaphoreTake(s_udp_data_mutex, pdMS_TO_TICKS(50)) == pdTRUE) {
        udp_node_data_t *target = NULL;
        if (strcmp(node, "S3_A") == 0 || strcmp(node, "S3A") == 0 || strcmp(node, "Node S3-A") == 0) {
            target = &s_udp_node1;
        } else if (strcmp(node, "S3_B") == 0 || strcmp(node, "S3B") == 0 || strcmp(node, "Node S3-B") == 0) {
            target = &s_udp_node2;
        }
        if (target) {
            target->valid = true;
            target->voc = voc;
            target->co2 = co2;
            target->eth = eth;
        }
        xSemaphoreGive(s_udp_data_mutex);
    }
}

void ui_get_node1_data(float *voc, int *co2, float *eth, bool *valid) {
    if (s_udp_data_mutex && xSemaphoreTake(s_udp_data_mutex, pdMS_TO_TICKS(50)) == pdTRUE) {
        *voc = s_udp_node1.voc;
        *co2 = s_udp_node1.co2;
        *eth = s_udp_node1.eth;
        *valid = s_udp_node1.valid;
        xSemaphoreGive(s_udp_data_mutex);
    } else {
        *voc = 0; *co2 = 0; *eth = 0; *valid = false;
    }
}

void ui_get_node2_data(float *voc, int *co2, float *eth, bool *valid) {
    if (s_udp_data_mutex && xSemaphoreTake(s_udp_data_mutex, pdMS_TO_TICKS(50)) == pdTRUE) {
        *voc = s_udp_node2.voc;
        *co2 = s_udp_node2.co2;
        *eth = s_udp_node2.eth;
        *valid = s_udp_node2.valid;
        xSemaphoreGive(s_udp_data_mutex);
    } else {
        *voc = 0; *co2 = 0; *eth = 0; *valid = false;
    }
}

const char* ui_get_ai_result(void) {
    return s_ai_result_buffer;
}
#endif

/* ========================================================================
 * NEW AI-CENTRIC DASHBOARD UI
 * ======================================================================== */

static lv_obj_t * ai_ring_outer;
static lv_obj_t * ai_ring_inner;
static lv_obj_t * ai_center_icon;
static lv_obj_t * ai_status_text;
static lv_obj_t * ai_sub_text;
static lv_obj_t * vol_slider;
static lv_obj_t * vol_label;
static lv_obj_t * btn_qr_entry;
static lv_obj_t * ptt_btn;
static lv_obj_t * ptt_btn_label;

static bool ai_service_running = false;
static int current_volume = 80;
static bool ptt_pressed = false;

static const lv_color_t COLOR_BG = lv_color_hex(0x0B1020);
static const lv_color_t COLOR_PANEL = lv_color_hex(0x151C30);
static const lv_color_t COLOR_PANEL_ALT = lv_color_hex(0x10182A);
static const lv_color_t COLOR_BORDER = lv_color_hex(0x26324A);
static const lv_color_t COLOR_TEXT = lv_color_hex(0xE6ECF5);
static const lv_color_t COLOR_MUTED = lv_color_hex(0x91A0B8);
static const lv_color_t COLOR_ACCENT = lv_color_hex(0x4AA3FF);
static const lv_color_t COLOR_SUCCESS = lv_color_hex(0x39D98A);
static const lv_color_t COLOR_WARNING = lv_color_hex(0xFFB84D);

static void refresh_ai_status_ui(void) {
    if (ai_center_icon == NULL || ai_status_text == NULL || ai_sub_text == NULL || ptt_btn == NULL || ptt_btn_label == NULL) {
        return;
    }

    xiaozhi_state_t state = xiaozhi_ai_service_get_state();
    ai_service_running = (state != XIAOZHI_STATE_IDLE && state != XIAOZHI_STATE_ERROR);
    if (!ai_service_running) {
        ptt_pressed = false;
    }

    uint32_t icon_color = 0xE0E0E0;
    const char * icon_text = LV_SYMBOL_AUDIO;
    const char * status_text = "Ready";
    const char * sub_text = "Press to talk";
    const char * button_text = "Hold To Talk";
    uint32_t button_bg = 0x1F6FEB;
    uint32_t button_text_color = 0xFFFFFF;

    switch (state) {
        case XIAOZHI_STATE_ACTIVATING:
            icon_color = 0xFFD166;
            icon_text = LV_SYMBOL_WARNING;
            status_text = "Activation Needed";
            sub_text = "Use code from serial log";
            button_text = "Retry After Activation";
            button_bg = 0x7A5C00;
            break;
        case XIAOZHI_STATE_LISTENING:
            icon_color = 0xFFD7D7;
            icon_text = LV_SYMBOL_AUDIO;
            status_text = "Listening...";
            sub_text = "Release to send";
            button_text = "Release To Send";
            button_bg = 0xC44545;
            break;
        case XIAOZHI_STATE_THINKING:
            icon_color = 0xE7D6FF;
            icon_text = LV_SYMBOL_SETTINGS;
            status_text = "Thinking...";
            sub_text = "Processing voice";
            button_text = "Thinking...";
            button_bg = 0x6C4CE3;
            break;
        case XIAOZHI_STATE_SPEAKING:
            icon_color = 0xD2FFF7;
            icon_text = LV_SYMBOL_VOLUME_MAX;
            status_text = "Speaking...";
            sub_text = "XiaoZhi replying";
            button_text = "Speaking...";
            button_bg = 0x11806A;
            break;
        case XIAOZHI_STATE_ERROR:
            icon_color = 0xFFD0D0;
            icon_text = LV_SYMBOL_WARNING;
            status_text = "Activation Needed";
            sub_text = "Use code from serial log";
            button_text = "Retry After Activation";
            button_bg = 0x7A5C00;
            break;
        case XIAOZHI_STATE_CONNECTED:
            icon_color = 0xE0EFFF;
            icon_text = LV_SYMBOL_AUDIO;
            status_text = "Ready";
            sub_text = "Hold to talk";
            button_text = ptt_pressed ? "Release To Send" : "Hold To Talk";
            button_bg = ptt_pressed ? 0xC44545 : 0x1F6FEB;
            break;
        default:
            if (ai_service_running) {
                icon_color = 0xE0EFFF;
                icon_text = LV_SYMBOL_REFRESH;
                status_text = "Connecting...";
                sub_text = "Wait for XiaoZhi ready";
                button_text = "Connecting...";
                button_bg = 0x415A77;
            }
            break;
    }

    lv_obj_set_style_text_color(ai_center_icon, lv_color_hex(icon_color), 0);
    lv_label_set_text(ai_center_icon, icon_text);
    lv_label_set_text(ai_status_text, status_text);
    lv_label_set_text(ai_sub_text, sub_text);
    lv_obj_set_style_bg_color(ptt_btn, lv_color_hex(button_bg), 0);
    lv_obj_set_style_text_color(ptt_btn_label, lv_color_hex(button_text_color), 0);
    lv_label_set_text(ptt_btn_label, button_text);
}

static void update_volume_ui(int vol, bool sync_sliders) {
    current_volume = vol;
    if (vol_label) {
        lv_label_set_text_fmt(vol_label, "%d%%", vol);
    }
    if (cc_volume_label) {
        lv_label_set_text_fmt(cc_volume_label, "%d%%", vol);
    }
    if (sync_sliders) {
        if (vol_slider) {
            lv_slider_set_value(vol_slider, vol, LV_ANIM_OFF);
        }
        if (cc_volume_slider) {
            lv_slider_set_value(cc_volume_slider, vol, LV_ANIM_OFF);
        }
    }
}

static void set_wifi_status_text(const char * text, lv_color_t color) {
    if (wifi_status_label) {
        lv_label_set_text(wifi_status_label, text);
        lv_obj_set_style_text_color(wifi_status_label, color, 0);
    }
    if (cc_wifi_status_label) {
        const char * cc_text = text;
        if (strncmp(text, "WiFi: ", 6) == 0) {
            cc_text = text + 6;
        }
        lv_label_set_text(cc_wifi_status_label, cc_text);
        lv_obj_set_style_text_color(cc_wifi_status_label, color, 0);
    }
}

static void cc_set_y(void * obj, int32_t y) {
    lv_obj_set_y((lv_obj_t *)obj, y);
}

static void close_control_center(void) {
    if (!cc_overlay || !cc_is_open) {
        return;
    }

    lv_obj_set_y(cc_overlay, -560);
    cc_is_open = false;
}

static void open_control_center(void) {
    if (!cc_overlay || cc_is_open) {
        return;
    }

    lv_obj_set_y(cc_overlay, 20);
    cc_is_open = true;
}

static void cc_close_btn_cb(lv_event_t * e) {
    LV_UNUSED(e);
    close_control_center();
}

static void cc_wifi_tile_cb(lv_event_t * e) {
    LV_UNUSED(e);
    close_control_center();
    btn_open_wifi_cb(NULL);
}

static void cc_brightness_slider_cb(lv_event_t * e) {
    lv_obj_t * slider = (lv_obj_t *)lv_event_get_target(e);
    int brightness = (int)lv_slider_get_value(slider);
    bsp_display_brightness_set(brightness);
}

static void main_screen_event_cb(lv_event_t * e) {
    if (lv_event_get_code(e) != LV_EVENT_GESTURE) {
        return;
    }

    lv_dir_t dir = lv_indev_get_gesture_dir(lv_indev_get_act());
    if (dir == LV_DIR_BOTTOM) {
        open_control_center();
    } else if (dir == LV_DIR_TOP) {
        close_control_center();
    }
}

static void control_center_init(lv_obj_t * parent) {
    cc_overlay = lv_obj_create(parent);
    apply_no_shadow(cc_overlay);
    lv_obj_set_size(cc_overlay, 980, 520);
    lv_obj_align(cc_overlay, LV_ALIGN_TOP_MID, 0, -560);
    lv_obj_set_style_bg_color(cc_overlay, COLOR_PANEL, 0);
    lv_obj_set_style_bg_opa(cc_overlay, LV_OPA_90, 0);
    lv_obj_set_style_border_color(cc_overlay, COLOR_BORDER, 0);
    lv_obj_set_style_border_width(cc_overlay, 1, 0);
    lv_obj_set_style_radius(cc_overlay, 28, 0);
    lv_obj_clear_flag(cc_overlay, LV_OBJ_FLAG_SCROLLABLE);

    lv_obj_t * title = lv_label_create(cc_overlay);
    lv_label_set_text(title, "CONTROL CENTER");
    lv_obj_set_style_text_font(title, &lv_font_montserrat_24, 0);
    lv_obj_set_style_text_color(title, COLOR_TEXT, 0);
    lv_obj_align(title, LV_ALIGN_TOP_LEFT, 36, 24);

    lv_obj_t * handle = lv_obj_create(cc_overlay);
    apply_no_shadow(handle);
    lv_obj_set_size(handle, 120, 6);
    lv_obj_align(handle, LV_ALIGN_TOP_MID, 0, 12);
    lv_obj_set_style_bg_color(handle, lv_color_hex(0x596273), 0);
    lv_obj_set_style_bg_opa(handle, LV_OPA_70, 0);
    lv_obj_set_style_radius(handle, 3, 0);
    lv_obj_clear_flag(handle, LV_OBJ_FLAG_SCROLLABLE);

    lv_obj_t * wifi_tile = lv_obj_create(cc_overlay);
    apply_no_shadow(wifi_tile);
    lv_obj_set_size(wifi_tile, 200, 180);
    lv_obj_align(wifi_tile, LV_ALIGN_TOP_LEFT, 36, 78);
    lv_obj_set_style_bg_color(wifi_tile, COLOR_PANEL_ALT, 0);
    lv_obj_set_style_bg_opa(wifi_tile, LV_OPA_COVER, 0);
    lv_obj_set_style_border_color(wifi_tile, COLOR_BORDER, 0);
    lv_obj_set_style_border_width(wifi_tile, 1, 0);
    lv_obj_set_style_radius(wifi_tile, 22, 0);
    lv_obj_clear_flag(wifi_tile, LV_OBJ_FLAG_SCROLLABLE);
    lv_obj_add_event_cb(wifi_tile, cc_wifi_tile_cb, LV_EVENT_CLICKED, NULL);

    lv_obj_t * wifi_icon = lv_label_create(wifi_tile);
    lv_label_set_text(wifi_icon, LV_SYMBOL_WIFI);
    lv_obj_set_style_text_font(wifi_icon, &lv_font_montserrat_32, 0);
    lv_obj_set_style_text_color(wifi_icon, COLOR_ACCENT, 0);
    lv_obj_align(wifi_icon, LV_ALIGN_TOP_MID, 0, 26);

    cc_wifi_status_label = lv_label_create(wifi_tile);
    lv_label_set_text(cc_wifi_status_label, "Disconnected");
    lv_obj_set_style_text_color(cc_wifi_status_label, COLOR_TEXT, 0);
    lv_obj_align(cc_wifi_status_label, LV_ALIGN_BOTTOM_MID, 0, -34);

    lv_obj_t * wifi_hint = lv_label_create(wifi_tile);
    lv_label_set_text(wifi_hint, "Tap to scan WiFi");
    lv_obj_set_style_text_color(wifi_hint, COLOR_MUTED, 0);
    lv_obj_align(wifi_hint, LV_ALIGN_BOTTOM_MID, 0, -12);

    lv_obj_t * bright_tile = lv_obj_create(cc_overlay);
    apply_no_shadow(bright_tile);
    lv_obj_set_size(bright_tile, 700, 120);
    lv_obj_align(bright_tile, LV_ALIGN_TOP_LEFT, 260, 78);
    lv_obj_set_style_bg_color(bright_tile, COLOR_PANEL_ALT, 0);
    lv_obj_set_style_bg_opa(bright_tile, LV_OPA_COVER, 0);
    lv_obj_set_style_border_color(bright_tile, COLOR_BORDER, 0);
    lv_obj_set_style_border_width(bright_tile, 1, 0);
    lv_obj_set_style_radius(bright_tile, 22, 0);
    lv_obj_clear_flag(bright_tile, LV_OBJ_FLAG_SCROLLABLE);

    lv_obj_t * bright_icon = lv_label_create(bright_tile);
    lv_label_set_text(bright_icon, LV_SYMBOL_SETTINGS);
    lv_obj_align(bright_icon, LV_ALIGN_LEFT_MID, 20, 0);

    cc_brightness_slider = lv_slider_create(bright_tile);
    lv_obj_set_size(cc_brightness_slider, 560, 16);
    lv_obj_align(cc_brightness_slider, LV_ALIGN_RIGHT_MID, -22, 0);
    lv_slider_set_range(cc_brightness_slider, 10, 100);
    lv_slider_set_value(cc_brightness_slider, 80, LV_ANIM_OFF);
    lv_obj_set_style_bg_color(cc_brightness_slider, lv_color_hex(0xFFCC00), LV_PART_INDICATOR);
    lv_obj_add_event_cb(cc_brightness_slider, cc_brightness_slider_cb, LV_EVENT_VALUE_CHANGED, NULL);

    lv_obj_t * volume_tile = lv_obj_create(cc_overlay);
    apply_no_shadow(volume_tile);
    lv_obj_set_size(volume_tile, 700, 120);
    lv_obj_align(volume_tile, LV_ALIGN_TOP_LEFT, 260, 222);
    lv_obj_set_style_bg_color(volume_tile, COLOR_PANEL_ALT, 0);
    lv_obj_set_style_bg_opa(volume_tile, LV_OPA_COVER, 0);
    lv_obj_set_style_border_color(volume_tile, COLOR_BORDER, 0);
    lv_obj_set_style_border_width(volume_tile, 1, 0);
    lv_obj_set_style_radius(volume_tile, 22, 0);
    lv_obj_clear_flag(volume_tile, LV_OBJ_FLAG_SCROLLABLE);

    lv_obj_t * volume_icon = lv_label_create(volume_tile);
    lv_label_set_text(volume_icon, LV_SYMBOL_VOLUME_MAX);
    lv_obj_align(volume_icon, LV_ALIGN_LEFT_MID, 20, 0);

    cc_volume_slider = lv_slider_create(volume_tile);
    lv_obj_set_size(cc_volume_slider, 520, 16);
    lv_obj_align(cc_volume_slider, LV_ALIGN_RIGHT_MID, -60, 10);
    lv_slider_set_range(cc_volume_slider, 0, 100);
    lv_obj_set_style_bg_color(cc_volume_slider, lv_color_hex(0x03DAC6), LV_PART_INDICATOR);
    lv_obj_add_event_cb(cc_volume_slider, vol_slider_event_cb, LV_EVENT_VALUE_CHANGED, NULL);

    cc_volume_label = lv_label_create(volume_tile);
    lv_label_set_text(cc_volume_label, "80%");
    lv_obj_set_style_text_color(cc_volume_label, COLOR_TEXT, 0);
    lv_obj_align(cc_volume_label, LV_ALIGN_RIGHT_MID, -16, -20);

    lv_obj_t * footer = lv_label_create(cc_overlay);
    lv_label_set_text(footer, "Swipe up anywhere to close");
    lv_obj_set_style_text_color(footer, COLOR_MUTED, 0);
    lv_obj_align(footer, LV_ALIGN_BOTTOM_MID, 0, -18);

    update_volume_ui(current_volume, true);
    set_wifi_status_text("WiFi: Disconnected", lv_color_hex(0xAAAAAA));
}

static void ptt_event_cb(lv_event_t * e) {
    lv_event_code_t code = lv_event_get_code(e);
    if (code != LV_EVENT_PRESSED && code != LV_EVENT_PRESSING && code != LV_EVENT_LONG_PRESSED &&
        code != LV_EVENT_RELEASED && code != LV_EVENT_PRESS_LOST &&
        code != LV_EVENT_SHORT_CLICKED && code != LV_EVENT_CLICKED) {
        return;
    }

    ESP_LOGI("UI", "PTT event: %d", (int)code);
    refresh_ai_status_ui();

    if (code == LV_EVENT_PRESSED || code == LV_EVENT_PRESSING || code == LV_EVENT_LONG_PRESSED) {
        if (wifi_conn_status != 2) {
            ESP_LOGW("UI", "PTT ignored: WiFi not connected");
            lv_label_set_text(ai_status_text, "WiFi Required");
            lv_label_set_text(ai_sub_text, "Connect WiFi first");
            return;
        }

        if (!ai_service_running) {
            if (xiaozhi_ai_service_start() == ESP_OK) {
                ai_service_running = true;
                ESP_LOGI("UI", "PTT started XiaoZhi service");
            } else {
                ESP_LOGW("UI", "PTT start request ignored: service already active or start failed");
            }
        }

        if (!ptt_pressed) {
            ptt_pressed = true;
            ESP_LOGI("UI", "PTT begin capture");
            xiaozhi_ai_service_set_ptt(true);
            refresh_ai_status_ui();
        }
    } else if (code == LV_EVENT_RELEASED || code == LV_EVENT_PRESS_LOST || code == LV_EVENT_SHORT_CLICKED || code == LV_EVENT_CLICKED) {
        if (ptt_pressed) {
            ESP_LOGI("UI", "PTT end capture");
            xiaozhi_ai_service_set_ptt(false);
        }
        ptt_pressed = false;
        refresh_ai_status_ui();
    }
}

void ui_init(void) {
    /* Initialize CJK font fallback (Montserrat + Full Han Sans SC) */
    memcpy(&s_font_cjk_fallback, &lv_font_montserrat_14, sizeof(lv_font_t));
    s_font_cjk_fallback.fallback = &lv_font_source_han_sans_sc_14_cjk;

    /* Initialize global no-shadow style ONCE */
    lv_style_init(&g_style_no_shadow);
    lv_style_set_shadow_width(&g_style_no_shadow, 0);
    lv_style_set_shadow_spread(&g_style_no_shadow, 0);
    lv_style_set_shadow_ofs_x(&g_style_no_shadow, 0);
    lv_style_set_shadow_ofs_y(&g_style_no_shadow, 0);

    /* Apply to root screens */
    lv_obj_add_style(lv_scr_act(), &g_style_no_shadow, 0);

    /* ====================================================================
     * 1. STARTUP SCREEN
     * ==================================================================== */
    scr_startup = lv_obj_create(NULL);
    apply_no_shadow(scr_startup);
    lv_obj_set_style_bg_color(scr_startup, COLOR_BG, 0);
    lv_obj_set_style_bg_opa(scr_startup, LV_OPA_COVER, 0);

    lv_obj_t * title = lv_label_create(scr_startup);
    lv_label_set_text(title, "E-Nose System");
    lv_obj_set_style_text_font(title, &lv_font_montserrat_24, 0);
    lv_obj_set_style_text_color(title, COLOR_TEXT, 0);
    lv_obj_align(title, LV_ALIGN_CENTER, 0, -88);

    lv_obj_t * subtitle = lv_label_create(scr_startup);
    lv_label_set_text(subtitle, "Edge sensing and XiaoZhi voice control");
    lv_obj_set_style_text_font(subtitle, &lv_font_montserrat_14, 0);
    lv_obj_set_style_text_color(subtitle, COLOR_MUTED, 0);
    lv_obj_align(subtitle, LV_ALIGN_CENTER, 0, -54);

    btn_wifi = lv_btn_create(scr_startup);
    lv_obj_set_size(btn_wifi, 320, 52);
    lv_obj_align(btn_wifi, LV_ALIGN_CENTER, 0, -6);
    lv_obj_set_style_bg_color(btn_wifi, COLOR_PANEL, 0);
    lv_obj_set_style_border_color(btn_wifi, COLOR_BORDER, 0);
    lv_obj_set_style_border_width(btn_wifi, 1, 0);
    lv_obj_set_style_radius(btn_wifi, 18, 0);
    lv_obj_add_event_cb(btn_wifi, btn_open_wifi_cb, LV_EVENT_CLICKED, NULL);
    wifi_status_label = lv_label_create(btn_wifi);
    lv_label_set_text(wifi_status_label, "WiFi: Disconnected");
    lv_obj_set_style_text_color(wifi_status_label, COLOR_TEXT, 0);

    lv_obj_t * btn_enter = lv_btn_create(scr_startup);
    lv_obj_set_size(btn_enter, 320, 56);
    lv_obj_align(btn_enter, LV_ALIGN_CENTER, 0, 68);
    lv_obj_set_style_bg_color(btn_enter, COLOR_ACCENT, 0);
    lv_obj_set_style_radius(btn_enter, 20, 0);
    lv_obj_add_event_cb(btn_enter, btn_enter_event_handler, LV_EVENT_CLICKED, NULL);

    lv_obj_t * btn_label = lv_label_create(btn_enter);
    lv_label_set_text(btn_label, "Enter Dashboard");
    lv_obj_set_style_text_color(btn_label, lv_color_hex(0xFFFFFF), 0);

    create_wifi_modals();

    /* ====================================================================
     * 2. MAIN DASHBOARD - AI-CENTRIC DESIGN
     * ==================================================================== */
    scr_main = lv_obj_create(NULL);
    apply_no_shadow(scr_main);
    lv_obj_set_style_bg_color(scr_main, COLOR_BG, 0);
    lv_obj_set_style_bg_opa(scr_main, LV_OPA_COVER, 0);
    lv_obj_clear_flag(scr_main, LV_OBJ_FLAG_SCROLLABLE);
    lv_obj_add_event_cb(scr_main, main_screen_event_cb, LV_EVENT_GESTURE, NULL);

    /* Title Bar */
    lv_obj_t * main_title = lv_label_create(scr_main);
    lv_label_set_text(main_title, "E-Nose Dashboard");
    lv_obj_set_style_text_font(main_title, &lv_font_montserrat_24, 0);
    lv_obj_set_style_text_color(main_title, COLOR_TEXT, 0);
    lv_obj_align(main_title, LV_ALIGN_TOP_LEFT, 34, 18);

    lv_obj_t * main_subtitle = lv_label_create(scr_main);
    lv_label_set_text(main_subtitle, "Stable local sensors with cloud voice assistant");
    lv_obj_set_style_text_font(main_subtitle, &lv_font_montserrat_12, 0);
    lv_obj_set_style_text_color(main_subtitle, COLOR_MUTED, 0);
    lv_obj_align(main_subtitle, LV_ALIGN_TOP_LEFT, 36, 52);

    /* Environment Sensor Panel */
    lv_obj_t * env_panel = lv_obj_create(scr_main);
    apply_no_shadow(env_panel);
    lv_obj_set_size(env_panel, 520, 72);
    lv_obj_align(env_panel, LV_ALIGN_TOP_LEFT, 34, 88);
    lv_obj_set_style_bg_color(env_panel, COLOR_PANEL_ALT, 0);
    lv_obj_set_style_bg_opa(env_panel, LV_OPA_COVER, 0);
    lv_obj_set_style_border_color(env_panel, COLOR_BORDER, 0);
    lv_obj_set_style_border_width(env_panel, 1, 0);
    lv_obj_set_style_radius(env_panel, 16, 0);

    lv_obj_t * env_title = lv_label_create(env_panel);
    lv_label_set_text(env_title, "Environment");
    lv_obj_set_style_text_font(env_title, &lv_font_montserrat_14, 0);
    lv_obj_set_style_text_color(env_title, COLOR_SUCCESS, 0);
    lv_obj_align(env_title, LV_ALIGN_TOP_LEFT, 16, 8);

    env_temp_label = lv_label_create(env_panel);
    lv_label_set_text(env_temp_label, "Temp: --.-C");
    lv_obj_set_style_text_font(env_temp_label, &lv_font_montserrat_12, 0);
    lv_obj_set_style_text_color(env_temp_label, COLOR_TEXT, 0);
    lv_obj_align(env_temp_label, LV_ALIGN_LEFT_MID, 18, -4);

    env_hum_label = lv_label_create(env_panel);
    lv_label_set_text(env_hum_label, "Humidity: --.-%");
    lv_obj_set_style_text_font(env_hum_label, &lv_font_montserrat_12, 0);
    lv_obj_set_style_text_color(env_hum_label, COLOR_TEXT, 0);
    lv_obj_align(env_hum_label, LV_ALIGN_LEFT_MID, 184, -4);

    env_press_label = lv_label_create(env_panel);
    lv_label_set_text(env_press_label, "Pressure: ----hPa");
    lv_obj_set_style_text_font(env_press_label, &lv_font_montserrat_12, 0);
    lv_obj_set_style_text_color(env_press_label, COLOR_TEXT, 0);
    lv_obj_align(env_press_label, LV_ALIGN_LEFT_MID, 352, -4);

    /* S3 Node Panels */
    lv_obj_t * panel1 = create_node_panel(scr_main, "Node S3-A", &node1_voc_label, &node1_co2_label, &node1_eth_label);
    lv_obj_set_style_bg_color(panel1, COLOR_PANEL, 0);
    lv_obj_set_style_border_color(panel1, COLOR_BORDER, 0);
    lv_obj_set_style_radius(panel1, 18, 0);
    lv_obj_align(panel1, LV_ALIGN_TOP_LEFT, 34, 184);

    lv_obj_t * panel2 = create_node_panel(scr_main, "Node S3-B", &node2_voc_label, &node2_co2_label, &node2_eth_label);
    lv_obj_set_style_bg_color(panel2, COLOR_PANEL, 0);
    lv_obj_set_style_border_color(panel2, COLOR_BORDER, 0);
    lv_obj_set_style_radius(panel2, 18, 0);
    lv_obj_align(panel2, LV_ALIGN_TOP_LEFT, 354, 184);

#ifdef CONFIG_ELEC_NOSE_GATEWAY_ENABLE
    /* AI Analysis Panel */
    lv_obj_t * ai_ctl_panel = lv_obj_create(scr_main);
    apply_no_shadow(ai_ctl_panel);
    lv_obj_set_size(ai_ctl_panel, 620, 60);
    lv_obj_align(ai_ctl_panel, LV_ALIGN_TOP_LEFT, 34, 350);
    lv_obj_set_style_bg_color(ai_ctl_panel, COLOR_PANEL_ALT, 0);
    lv_obj_set_style_bg_opa(ai_ctl_panel, LV_OPA_COVER, 0);
    lv_obj_set_style_border_color(ai_ctl_panel, COLOR_ACCENT, 0);
    lv_obj_set_style_border_width(ai_ctl_panel, 1, 0);
    lv_obj_set_style_radius(ai_ctl_panel, 16, 0);

    ai_analyze_btn = lv_btn_create(ai_ctl_panel);
    lv_obj_set_size(ai_analyze_btn, 180, 40);
    lv_obj_center(ai_analyze_btn);
    lv_obj_set_style_bg_color(ai_analyze_btn, lv_color_hex(0x4AA3FF), 0);
    lv_obj_set_style_radius(ai_analyze_btn, 14, 0);
    lv_obj_add_event_cb(ai_analyze_btn, ai_analyze_btn_cb, LV_EVENT_CLICKED, NULL);

    ai_analyze_btn_label = lv_label_create(ai_analyze_btn);
    lv_label_set_text(ai_analyze_btn_label, "AI Analysis");
    lv_obj_center(ai_analyze_btn_label);
    lv_obj_set_style_text_color(ai_analyze_btn_label, lv_color_hex(0xFFFFFF), 0);
    lv_obj_set_style_text_font(ai_analyze_btn_label, &lv_font_montserrat_14, 0);
#endif

    /* ====================================================================
     * AI INTERACTION CENTER - functional lightweight version
     * ==================================================================== */

    lv_obj_t * ai_panel = lv_obj_create(scr_main);
    apply_no_shadow(ai_panel);
    lv_obj_set_size(ai_panel, 292, 220);
    lv_obj_align(ai_panel, LV_ALIGN_TOP_RIGHT, -34, 96);
    lv_obj_set_style_bg_color(ai_panel, COLOR_PANEL, 0);
    lv_obj_set_style_bg_opa(ai_panel, LV_OPA_COVER, 0);
    lv_obj_set_style_border_color(ai_panel, COLOR_ACCENT, 0);
    lv_obj_set_style_border_width(ai_panel, 1, 0);
    lv_obj_set_style_radius(ai_panel, 22, 0);
    lv_obj_clear_flag(ai_panel, LV_OBJ_FLAG_SCROLLABLE);

    ai_center_icon = lv_label_create(ai_panel);
    lv_label_set_text(ai_center_icon, LV_SYMBOL_AUDIO);
    lv_obj_set_style_text_font(ai_center_icon, &lv_font_montserrat_32, 0);
    lv_obj_set_style_text_color(ai_center_icon, COLOR_TEXT, 0);
    lv_obj_align(ai_center_icon, LV_ALIGN_TOP_MID, 0, 24);

    ai_status_text = lv_label_create(ai_panel);
    lv_label_set_text(ai_status_text, "Ready");
    lv_obj_set_style_text_font(ai_status_text, &lv_font_montserrat_20, 0);
    lv_obj_set_style_text_color(ai_status_text, COLOR_TEXT, 0);
    lv_obj_align(ai_status_text, LV_ALIGN_TOP_MID, 0, 76);

    ai_sub_text = lv_label_create(ai_panel);
    lv_label_set_text(ai_sub_text, "Press to talk");
    lv_obj_set_style_text_font(ai_sub_text, &lv_font_montserrat_12, 0);
    lv_obj_set_style_text_color(ai_sub_text, COLOR_MUTED, 0);
    lv_obj_align(ai_sub_text, LV_ALIGN_TOP_MID, 0, 110);

    ptt_btn = lv_btn_create(ai_panel);
    apply_no_shadow(ptt_btn);
    lv_obj_set_size(ptt_btn, 208, 50);
    lv_obj_align(ptt_btn, LV_ALIGN_BOTTOM_MID, 0, -18);
    lv_obj_set_style_bg_color(ptt_btn, lv_color_hex(0x1F6FEB), 0);
    lv_obj_set_style_bg_opa(ptt_btn, LV_OPA_COVER, 0);
    lv_obj_set_style_border_width(ptt_btn, 0, 0);
    lv_obj_set_style_radius(ptt_btn, 18, 0);
    lv_obj_add_flag(ptt_btn, LV_OBJ_FLAG_PRESS_LOCK);
    lv_obj_add_event_cb(ptt_btn, ptt_event_cb, LV_EVENT_PRESSED, NULL);
    lv_obj_add_event_cb(ptt_btn, ptt_event_cb, LV_EVENT_PRESSING, NULL);
    lv_obj_add_event_cb(ptt_btn, ptt_event_cb, LV_EVENT_LONG_PRESSED, NULL);
    lv_obj_add_event_cb(ptt_btn, ptt_event_cb, LV_EVENT_RELEASED, NULL);
    lv_obj_add_event_cb(ptt_btn, ptt_event_cb, LV_EVENT_PRESS_LOST, NULL);
    lv_obj_add_event_cb(ptt_btn, ptt_event_cb, LV_EVENT_SHORT_CLICKED, NULL);
    lv_obj_add_event_cb(ptt_btn, ptt_event_cb, LV_EVENT_CLICKED, NULL);

    ptt_btn_label = lv_label_create(ptt_btn);
    lv_label_set_text(ptt_btn_label, "Hold To Talk");
    lv_obj_set_style_text_font(ptt_btn_label, &lv_font_montserrat_14, 0);
    lv_obj_set_style_text_color(ptt_btn_label, lv_color_hex(0xFFFFFF), 0);
    lv_obj_center(ptt_btn_label);

    ai_ring_outer = ai_panel;
    ai_ring_inner = ai_panel;

    /* Volume Control Panel */
    lv_obj_t * vol_panel = lv_obj_create(scr_main);
    apply_no_shadow(vol_panel);
    lv_obj_set_size(vol_panel, 292, 58);
    lv_obj_align(vol_panel, LV_ALIGN_BOTTOM_RIGHT, -34, -26);
    lv_obj_set_style_bg_color(vol_panel, COLOR_PANEL_ALT, 0);
    lv_obj_set_style_bg_opa(vol_panel, LV_OPA_COVER, 0);
    lv_obj_set_style_border_color(vol_panel, COLOR_BORDER, 0);
    lv_obj_set_style_border_width(vol_panel, 1, 0);
    lv_obj_set_style_radius(vol_panel, 18, 0);
    lv_obj_set_scrollbar_mode(vol_panel, LV_SCROLLBAR_MODE_OFF);

    lv_obj_t * speaker_icon = lv_label_create(vol_panel);
    lv_label_set_text(speaker_icon, LV_SYMBOL_VOLUME_MAX);
    lv_obj_align(speaker_icon, LV_ALIGN_LEFT_MID, 10, 0);
    lv_obj_set_style_text_font(speaker_icon, &lv_font_montserrat_20, 0);
    lv_obj_set_style_text_color(speaker_icon, COLOR_SUCCESS, 0);

    vol_slider = lv_slider_create(vol_panel);
    lv_obj_set_width(vol_slider, 124);
    lv_obj_align(vol_slider, LV_ALIGN_CENTER, 26, 0);
    lv_slider_set_range(vol_slider, 0, 100);
    lv_slider_set_value(vol_slider, current_volume, LV_ANIM_OFF);
    lv_obj_set_style_bg_color(vol_slider, COLOR_SUCCESS, LV_PART_INDICATOR);
    lv_obj_set_style_bg_color(vol_slider, COLOR_BORDER, LV_PART_MAIN);
    lv_obj_add_event_cb(vol_slider, vol_slider_event_cb, LV_EVENT_VALUE_CHANGED, NULL);

    vol_label = lv_label_create(vol_panel);
    lv_label_set_text_fmt(vol_label, "%d%%", current_volume);
    lv_obj_align(vol_label, LV_ALIGN_RIGHT_MID, -5, 0);
    lv_obj_set_style_text_font(vol_label, &lv_font_montserrat_12, 0);
    lv_obj_set_style_text_color(vol_label, COLOR_TEXT, 0);

    /* QR Scan Entry Button */
    btn_qr_entry = lv_btn_create(scr_main);
    lv_obj_set_size(btn_qr_entry, 178, 50);
    lv_obj_align(btn_qr_entry, LV_ALIGN_BOTTOM_LEFT, 34, -28);
    lv_obj_set_style_bg_color(btn_qr_entry, lv_color_hex(0x6C4CE3), 0);
    lv_obj_set_style_radius(btn_qr_entry, 18, 0);
    lv_obj_t * lbl_qr = lv_label_create(btn_qr_entry);
    lv_label_set_text(lbl_qr, LV_SYMBOL_IMAGE " QR Scanner");
    lv_obj_set_style_text_color(lbl_qr, lv_color_hex(0xFFFFFF), 0);

    /* Keep AI area static for now; avoid periodic LVGL churn */
    refresh_ai_status_ui();

    control_center_init(scr_main);

    /* ====================================================================
     * 3. QR SCAN SCREEN
     * ==================================================================== */
    scr_qr = lv_obj_create(NULL);
    apply_no_shadow(scr_qr);
    lv_obj_set_style_bg_color(scr_qr, lv_color_hex(0x0A0A1A), 0);
    lv_obj_set_style_bg_opa(scr_qr, LV_OPA_COVER, 0);

    cam_img_obj = lv_img_create(scr_qr);
    lv_obj_set_pos(cam_img_obj, 0, 60);
    lv_obj_set_size(cam_img_obj, 1024, 540);

    lv_obj_t * qr_title = lv_label_create(scr_qr);
    lv_label_set_text(qr_title, "E-Nose Node Scanner");
    lv_obj_set_style_text_color(qr_title, lv_color_hex(0x00FF88), 0);
    lv_obj_align(qr_title, LV_ALIGN_TOP_MID, 0, 10);

    lv_obj_t * btn_qr_back = lv_btn_create(scr_qr);
    lv_obj_set_pos(btn_qr_back, 10, 60);
    lv_obj_set_size(btn_qr_back, 80, 40);
    lv_obj_set_style_bg_color(btn_qr_back, lv_color_hex(0x444444), 0);
    lv_obj_set_style_radius(btn_qr_back, 5, 0);
    lv_obj_t * lbl_qr_back = lv_label_create(btn_qr_back);
    lv_label_set_text(lbl_qr_back, "< Back");
    lv_obj_set_style_text_color(lbl_qr_back, lv_color_hex(0xFFFFFF), 0);
    lv_obj_center(lbl_qr_back);

    lv_obj_t * scan_hint = lv_label_create(scr_qr);
    lv_label_set_text(scan_hint, "Place QR in camera view");
    lv_obj_set_style_text_color(scan_hint, lv_color_hex(0x00FFFF), 0);
    lv_obj_align(scan_hint, LV_ALIGN_BOTTOM_MID, 0, -100);

    lv_obj_t * scan_box = lv_obj_create(scr_qr);
    apply_no_shadow(scan_box);
    lv_obj_set_pos(scan_box, 412, 200);
    lv_obj_set_size(scan_box, 200, 200);
    lv_obj_set_style_bg_opa(scan_box, LV_OPA_TRANSP, 0);
    lv_obj_set_style_border_color(scan_box, lv_color_hex(0x00FF00), 0);
    lv_obj_set_style_border_width(scan_box, 3, 0);
    lv_obj_set_style_radius(scan_box, 10, 0);

    qr_result_panel = lv_obj_create(scr_qr);
    apply_no_shadow(qr_result_panel);
    lv_obj_set_size(qr_result_panel, 200, 100);
    lv_obj_align(qr_result_panel, LV_ALIGN_BOTTOM_MID, 0, -20);
    lv_obj_set_style_bg_color(qr_result_panel, lv_color_hex(0x000000), 0);
    lv_obj_set_style_bg_opa(qr_result_panel, LV_OPA_70, 0);
    lv_obj_set_style_border_color(qr_result_panel, lv_color_hex(0x00FFFF), 0);
    lv_obj_set_style_border_width(qr_result_panel, 1, 0);
    lv_obj_set_style_radius(qr_result_panel, 10, 0);
    lv_obj_add_flag(qr_result_panel, LV_OBJ_FLAG_HIDDEN);
    
    qr_result_label = lv_label_create(qr_result_panel);
    lv_label_set_text(qr_result_label, "Waiting for QR...");
    lv_obj_set_style_text_color(qr_result_label, lv_color_hex(0x00FF88), 0);
    lv_obj_align(qr_result_label, LV_ALIGN_CENTER, 0, 0);

    lv_obj_add_event_cb(btn_qr_entry, [](lv_event_t * e){
        ESP_LOGI("CAM", "QR Scanner button clicked");
        lv_screen_load(scr_qr);
        lv_obj_add_flag(qr_result_panel, LV_OBJ_FLAG_HIDDEN);
        camera_display_initialized = false;
        camera_stream_stopping = false;
        cam_scale_applied = false;
        if(video_fd < 0) {
            ESP_LOGI("CAM", "Opening camera device...");
            if(!camera_initialized) {
                i2c_master_bus_handle_t i2c_bus = bsp_i2c_get_handle();
                esp_err_t ret1 = app_video_main(i2c_bus);
                if (ret1 != ESP_OK) {
                    ESP_LOGE("CAM", "Camera sensor init failed: %s", esp_err_to_name(ret1));
                } else {
                    ESP_LOGI("CAM", "Camera sensor initialized successfully");
                    camera_initialized = true;
                }
            } else {
                ESP_LOGI("CAM", "Camera already initialized");
            }
            
            app_video_register_frame_operation_cb(camera_frame_cb);
            ESP_LOGI("CAM", "Frame callback registered");
            
            video_fd = app_video_open((char*)"/dev/video0", (video_fmt_t)APP_VIDEO_FMT_RGB565);
            if(video_fd < 0) {
                ESP_LOGE("CAM", "Failed to open camera device");
                return;
            }
            ESP_LOGI("CAM", "Camera device opened, fd=%d", video_fd);
            
            esp_cache_get_alignment(MALLOC_CAP_SPIRAM, &cam_alignment);
            cam_buf_size = app_video_get_buf_size();
            ESP_LOGI("CAM", "Buffer size: %zu bytes, alignment: %zu", cam_buf_size, cam_alignment);
            
            if(cam_buf_size == 0) {
                ESP_LOGE("CAM", "Invalid buffer size");
                close(video_fd);
                video_fd = -1;
                return;
            }
            
            for(int i = 0; i < CAM_BUF_NUM; i++) {
                cam_buffers[i] = (uint8_t *)heap_caps_aligned_alloc(cam_alignment, cam_buf_size, MALLOC_CAP_SPIRAM);
                if(!cam_buffers[i]) {
                    ESP_LOGE("CAM", "Failed to allocate buffer %d", i);
                    for(int j = 0; j < i; j++) {
                        heap_caps_free(cam_buffers[j]);
                        cam_buffers[j] = NULL;
                    }
                    close(video_fd);
                    video_fd = -1;
                    return;
                }
                ESP_LOGI("CAM", "Buffer %d allocated at %p", i, cam_buffers[i]);
            }
            
            ESP_LOGI("CAM", "Setting up %d buffers in USERPTR mode...", CAM_BUF_NUM);
            esp_err_t ret2 = app_video_set_bufs(video_fd, CAM_BUF_NUM, (const void **)cam_buffers);
            if(ret2 != ESP_OK) {
                ESP_LOGE("CAM", "Failed to set video buffers: %s", esp_err_to_name(ret2));
                for(int i = 0; i < CAM_BUF_NUM; i++) {
                    if(cam_buffers[i]) heap_caps_free(cam_buffers[i]);
                }
                close(video_fd);
                video_fd = -1;
                return;
            }
            
            ESP_LOGI("CAM", "Starting video stream task...");
            esp_err_t ret3 = app_video_stream_task_start(video_fd, 0);
            if(ret3 != ESP_OK) {
                ESP_LOGE("CAM", "Failed to start video stream task: %s", esp_err_to_name(ret3));
                for(int i = 0; i < CAM_BUF_NUM; i++) {
                    if(cam_buffers[i]) heap_caps_free(cam_buffers[i]);
                    cam_buffers[i] = NULL;
                }
                close(video_fd);
                video_fd = -1;
                // Keep camera_initialized = true: esp_video_init() already registered ISP device,
                // calling it again would fail with "video name=ISP has been registered"
                return;
            }
            
            ESP_LOGI("CAM", "Camera stream started successfully");
            vTaskDelay(pdMS_TO_TICKS(500));
            camera_display_initialized = true;
        } else {
            ESP_LOGI("CAM", "Camera already running (fd=%d)", video_fd);
            camera_display_initialized = true;
        }
    }, LV_EVENT_CLICKED, NULL);

    lv_obj_add_event_cb(btn_qr_back, [](lv_event_t * e){
        camera_display_initialized = false;
        camera_stream_stopping = true;
        cam_scale_applied = false;
        cam_header_set = false;
        disp_busy = false;
        
        if(video_fd >= 0) {
            ESP_LOGI("CAM", "Stopping video stream...");
            app_video_stream_task_stop(video_fd);
            vTaskDelay(pdMS_TO_TICKS(200));
            app_video_stream_wait_stop();
            close(video_fd);
            video_fd = -1;
            
            for(int i = 0; i < CAM_BUF_NUM; i++) {
                if(cam_buffers[i]) {
                    heap_caps_free(cam_buffers[i]);
                    cam_buffers[i] = NULL;
                }
            }
            
            for(int i = 0; i < DISP_BUF_COUNT; i++) {
                if(disp_buffers[i]) {
                    heap_caps_free(disp_buffers[i]);
                    disp_buffers[i] = NULL;
                }
            }
            
            if (q_cv) {
                quirc_destroy(q_cv);
                q_cv = NULL;
            }
            
            ESP_LOGI("CAM", "Camera and display resources freed");
        }

        camera_stream_stopping = false;
        
        lv_screen_load(scr_main);
    }, LV_EVENT_CLICKED, NULL);

    lv_screen_load(scr_startup);
}

/* Web camera: JPEG pre-encoded in camera callback, HTTP handler just reads it */

bool ui_is_camera_available(void) {
    return web_jpeg_available();
}

bool ui_get_camera_frame(uint8_t **buf, uint32_t *w, uint32_t *h, size_t *len) {
    return web_jpeg_get_frame(buf, w, h, len);
}
